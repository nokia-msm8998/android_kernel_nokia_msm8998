/* Copyright (c) 2013, The Linux Foundation. All rights reserved.
 *
 * This program is free software; you can redistribute it and/or modify
 * it under the terms of the GNU General Public License version 2 and
 * only version 2 as published by the Free Software Foundation.
 *
 * This program is distributed in the hope that it will be useful,
 * but WITHOUT ANY WARRANTY; without even the implied warranty of
 * MERCHANTABILITY or FITNESS FOR A PARTICULAR PURPOSE.  See the
 * GNU General Public License for more details.
 */

/* Thermal */
#include "fih_thermal.dtsi"
 
/* Power */
#include "fih_power.dtsi"
/* Memory */
#include "fih_memmap_a1n_evb.dtsi"

/*PIN ctrl*/
#include "msm8998-pinctrl-A1N.dtsi"
/* Display */
#include "Display-nt36850.dtsi"
/* Touch Panel */
#include "touch_fts.dtsi"

/* Camera */
#include "camera-evt1.dtsi"

/* Audio */
#include "audio-alsa-evt.dtsi"

/* Peripherals */

/* Wireless */

/* Sensor */

/* LEDS */
#include "hall.dtsi"
#include "keypad.dtsi"
#include "vibrator.dtsi"
#include "rgb.dtsi"

/* USB */
#include "A1N_usb.dtsi"

/* FINGERPRINT */
/* Add for GOODIX fingerprint */
#include "fingerprint-gf5288-evt.dtsi"
/* KC Add for external LDO control */
#include "fixed-regulator-EVT-v1.dtsi"

/* NFC, NXP PN547 */
#include "nfc-nxp-pn547.dtsi"

/* Remove SDHC */
#include "sdhc.dtsi"

/* Wireless Charging*/
#include "wireless-charging-P9221.dtsi"
