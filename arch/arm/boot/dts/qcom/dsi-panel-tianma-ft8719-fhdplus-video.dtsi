/* Copyright (c) 2017, The Linux Foundation. All rights reserved.
 *
 * This program is free software; you can redistribute it and/or modify
 * it under the terms of the GNU General Public License version 2 and
 * only version 2 as published by the Free Software Foundation.
 *
 * This program is distributed in the hope that it will be useful,
 * but WITHOUT ANY WARRANTY; without even the implied warranty of
 * MERCHANTABILITY or FITNESS FOR A PARTICULAR PURPOSE.  See the
 * GNU General Public License for more details.
 */

&mdss_mdp {
	dsi_ft8719_tianma_fhdplus_video:  qcom,mdss_dsi_ft8719_tianma_fhdplus_video {
		qcom,mdss-dsi-panel-name = "tianma ft8719 fhdplus video mode dsi panel";
		qcom,mdss-dsi-panel-controller = <&mdss_dsi0>;
		qcom,mdss-dsi-panel-type = "dsi_video_mode";
		qcom,mdss-dsi-panel-framerate = <60>;
		qcom,mdss-dsi-panel-clockrate = <998400000>;
		qcom,mdss-dsi-virtual-channel-id = <0>;
		qcom,mdss-dsi-stream = <0>;
		qcom,mdss-dsi-panel-width = <1080>;
		qcom,mdss-dsi-panel-height = <2340>;
		qcom,mdss-pan-physical-width-dimension = <67>;//modify by shenwenbin for error inch 20190422
		qcom,mdss-pan-physical-height-dimension = <145>;//modify by shenwenbin for error inch 20190422
		qcom,mdss-dsi-h-front-porch = <24>;
		qcom,mdss-dsi-h-back-porch = <4>;
		qcom,mdss-dsi-h-pulse-width = <12>;
		qcom,mdss-dsi-h-sync-skew = <0>;
		qcom,mdss-dsi-v-back-porch = <12>;
		qcom,mdss-dsi-v-front-porch = <120>;
		qcom,mdss-dsi-v-pulse-width = <4>;
		qcom,mdss-dsi-h-left-border = <0>;
		qcom,mdss-dsi-h-right-border = <0>;
		qcom,mdss-dsi-v-top-border = <0>;
		qcom,mdss-dsi-v-bottom-border = <0>;
		qcom,mdss-dsi-bpp = <24>;
		qcom,mdss-dsi-underflow-color = <0xff>;
		qcom,mdss-dsi-border-color = <0>;
		qcom,mdss-dsi-h-sync-pulse = <0>;
		qcom,mdss-dsi-traffic-mode = "burst_mode";
		qcom,mdss-dsi-lane-map = "lane_map_0123";
		qcom,mdss-dsi-bllp-eof-power-mode;
		qcom,mdss-dsi-bllp-power-mode;
		qcom,mdss-dsi-lane-0-state;
		qcom,mdss-dsi-lane-1-state;
		qcom,mdss-dsi-lane-2-state;
		qcom,mdss-dsi-lane-3-state;
		qcom,mdss-dsi-panel-timings = [f8 3c 28 00 6e 72 2e
				40 30 03 04 00];
		qcom,mdss-dsi-t-clk-post = <0x0E>;
		qcom,mdss-dsi-t-clk-pre = <0x35>;
		qcom,mdss-dsi-bl-min-level = <1>;
		qcom,mdss-dsi-bl-max-level = <4095>;
		qcom,mdss-dsi-dma-trigger = "trigger_sw";
		qcom,mdss-dsi-mdp-trigger = "none";
		qcom,mdss-dsi-on-command = [
		         /*PX8418 bypass mode*/
                        //29 01 00 00 01 00 14 f4 ff ff ff 04 00 c0 f0 01 00 00 00 00 00 c0 f0 39 c1 01 02
                        //29 01 00 00 0a 00 14 f4 ff ff ff 68 00 00 f0 02 00 00 00 68 00 00 f0 00 00 00 00
                        /*PX8418 bypass mode*/
                        05 01 00 00 78 00 02 11 00
                        29 01 00 00 00 00 02 00 00
			29 01 00 00 00 00 04 ff 87 19 01
			29 01 00 00 00 00 02 00 80
			29 01 00 00 00 00 03 ff 87 19 
			15 01 00 00 00 00 02 51 00
			15 01 00 00 00 00 02 53 00
			15 01 00 00 00 00 02 55 00
			15 01 00 00 00 00 02 35 00
			05 01 00 00 14 00 02 29 00];
		/*modify by shenwenbin for sleep spi electric leakage 20190429 begin*/
		qcom,mdss-dsi-off-command = [
                        05 01 00 00 14 00 01 28 
                        05 01 00 00 78 00 01 10 
                        29 01 00 00 00 00 02 00 00 
                        29 01 00 00 00 00 04 FF 87 19 01 
                        29 01 00 00 00 00 02 00 80 
                        29 01 00 00 00 00 03 FF 87 19 
                        29 01 00 00 00 00 02 00 00 
                        29 01 00 00 00 00 05 F7 5A A5 95 27];
                /*modify by shenwenbin for sleep spi electric leakage 20190429 end*/
		qcom,mdss-dsi-on-command-state = "dsi_lp_mode";
		qcom,mdss-dsi-off-command-state = "dsi_hs_mode";

		qcom,mdss-dsi-bl-pmic-control-type = "bl_ctrl_wled";
		qcom,mdss-dsi-reset-sequence = <1 4>, <0 1>, <1 11>;
                qcom,mdss-dsi-panel-hwid = <101>; //modify by shenwenbin for sleep spi electric leakage 20190429
		/*add by shenwenbin for LCD ESD check need use TP read status 20190428 begin*/
                qcom,esd-check-enabled;
                qcom,mdss-dsi-panel-status-check-mode="tp_check";
                /*add by shenwenbin for LCD ESD check need use TP read status 20190428 end*/

		qcom,mdss-dsi-panel-hdr-enabled;
		qcom,mdss-dsi-panel-hdr-color-primaries = <14500 15500 32000 17000 15500 30000 8000 3000>;
		qcom,mdss-dsi-panel-peak-brightness = <3500000>;
		qcom,mdss-dsi-panel-blackness-level = <30>;
	};
};
