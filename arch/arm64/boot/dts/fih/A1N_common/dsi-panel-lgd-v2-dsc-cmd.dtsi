/* Copyright (c) 2015, The Linux Foundation. All rights reserved.
 *
 * This program is free software; you can redistribute it and/or modify
 * it under the terms of the GNU General Public License version 2 and
 * only version 2 as published by the Free Software Foundation.
 *
 * This program is distributed in the hope that it will be useful,
 * but WITHOUT ANY WARRANTY; without even the implied warranty of
 * MERCHANTABILITY or FITNESS FOR A PARTICULAR PURPOSE.  See the
 * GNU General Public License for more details.
 */

&mdss_mdp {
	lgd_v2_wqhd_dsc_cmd: qcom,mdss_dsi_lgd_v2_wqhd_dsc_cmd {
		qcom,mdss-dsi-panel-name =
			"LGD cmd mode dsc dsi panel";
		qcom,mdss-dsi-panel-type = "dsi_cmd_mode";
		qcom,mdss-dsi-panel-framerate = <60>;
		qcom,mdss-dsi-panel-clockrate = <580000000>;
		qcom,mdss-dsi-virtual-channel-id = <0>;
		qcom,mdss-dsi-stream = <0>;
		fih,panel-id = <4>;
		fih,aod-early-lp-exit;
		qcom,mdss-dsi-panel-width = <1440>;
		qcom,mdss-dsi-panel-height = <2560>;
		qcom,mdss-dsi-h-front-porch = <96>;
		qcom,mdss-dsi-h-back-porch = <84>;
		qcom,mdss-dsi-h-pulse-width = <32>;
		qcom,mdss-dsi-h-sync-skew = <0>;
		qcom,mdss-dsi-v-back-porch = <20>;
		qcom,mdss-dsi-v-front-porch = <20>;
		qcom,mdss-dsi-v-pulse-width = <4>;
		qcom,mdss-dsi-bpp = <24>;
		qcom,mdss-dsi-border-color = <0>;
		qcom,mdss-dsi-h-sync-pulse = <0>;
		qcom,mdss-dsi-traffic-mode = "non_burst_sync_event";
		qcom,mdss-dsi-bllp-eof-power-mode;
		qcom,mdss-dsi-bllp-power-mode;
		qcom,mdss-dsi-lp11-init;
		qcom,mdss-dsi-tx-eot-append;
		qcom,mdss-dsi-lane-0-state;
		qcom,mdss-dsi-lane-1-state;
		qcom,mdss-dsi-lane-2-state;
		qcom,mdss-dsi-lane-3-state;
		qcom,mdss-dsi-dma-trigger = "trigger_sw";
		qcom,mdss-dsi-mdp-trigger = "none";
		qcom,mdss-dsi-reset-sequence = <1 10>, <0 10>, <1 10>;
		qcom,mdss-pan-physical-width-dimension = <68>;
		qcom,mdss-pan-physical-height-dimension = <121>;
		qcom,mdss-dsi-te-pin-select = <1>;
		qcom,mdss-dsi-wr-mem-start = <0x2c>;
		qcom,mdss-dsi-wr-mem-continue = <0x3c>;
		qcom,mdss-dsi-te-dcs-command = <1>;
		qcom,mdss-dsi-te-check-enable;
		qcom,mdss-dsi-te-using-te-pin;
		qcom,mdss-pan-physical-width-dimension-full = <6804>;
		qcom,mdss-pan-physical-height-dimension-full = <12096>;
//		qcom,ulps-enabled;
//		qcom,suspend-ulps-enabled;
		qcom,adjust-timer-wakeup-ms = <1>;
		qcom,mdss-dsi-on-command-state = "dsi_hs_mode";
		qcom,mdss-dsi-off-command-state = "dsi_hs_mode";

		qcom,mdss-dsi-aod-resume-command-state = "dsi_hs_mode";
		qcom,mdss-dsi-aod-suspend-command-state = "dsi_hs_mode";
		qcom,mdss-dsi-panel-orientation="180";
		fih,color_managerial;

		//Enable ESD checking
		qcom,esd-check-enabled;
		qcom,mdss-dsi-panel-status-check-mode = "te_signal_check";

		qcom,mdss-dsi-aod-suspend-command = [
			39 01 00 00 00 00 03 7F 5A 5A
			39 01 00 00 00 00 03 F0 5A 5A
			39 01 00 00 00 00 03 F1 5A 5A
			39 01 00 00 00 00 03 F2 5A 5A
			05 01 00 00 00 00 02 28 00
			15 01 00 00 00 00 02 B0 0A
			39 01 00 00 00 00 03 C2 8C 80
			15 01 00 00 00 00 02 57 06
			15 01 00 00 00 00 02 5A 00
			15 01 00 00 00 00 02 B0 05
			15 01 00 00 00 00 02 E3 03
			15 01 00 00 00 00 02 C0 01
			05 01 00 00 00 00 02 12 00
			15 01 00 00 00 00 02 B0 07
			39 01 00 00 00 00 04 B2 00 00 00
			05 01 00 00 64 00 02 39 00
			//15 01 00 00 64 00 02 51 03
			05 01 00 00 00 00 02 29 00
		];

		qcom,mdss-dsi-aod-resume-command = [
			15 01 00 00 64 00 02 51 00
			15 01 00 00 00 00 02 B0 0A
			39 01 00 00 00 00 03 C2 92 40
			05 01 00 00 00 00 02 28 00
			05 01 00 00 00 00 02 38 00
			05 01 00 00 32 00 02 13 00
			05 01 00 00 64 00 02 10 00

			39 01 00 00 00 00 03 7F 5A 5A
			39 01 00 00 00 00 03 F0 5A 5A
			39 01 00 00 00 00 03 F1 5A 5A
			39 01 00 00 00 00 03 F2 5A 5A
			15 01 00 00 00 00 02 02 01
			15 01 00 00 00 00 02 36 02
			15 01 00 00 00 00 02 53 20
			15 01 00 00 00 00 02 57 64
			15 01 00 00 00 00 02 58 00
			15 01 00 00 00 00 02 35 01
			05 01 00 00 78 00 02 11 00
			15 01 00 00 00 00 02 B0 00
			39 01 00 00 00 00 32 CB 0B 80 80 80 80 80 80 80 80 80 80 80 80 80 80 80 80 80 80 80 80 80 80 80 80 7F 7F 7F 7F 7F 7F 7F 7F 7F 7F 7F 7F FF FF FF FF FF FF FF FF FF FF FF FF
			15 01 00 00 00 00 02 B0 31
			39 01 00 00 00 00 32 CB 0B 80 80 80 80 80 80 80 80 80 80 80 80 5C 64 6E 60 7C 70 7A 78 6C 5E 5E 52 7F 7E 7F 7E 7F 7D 7F 7E 7E 7F 7F 7F FF 0C 03 ED 06 15 F6 F2 ED 00 00 F6
			15 01 00 00 00 00 02 B0 62
			39 01 00 00 00 00 32 CB 0B 80 80 80 80 80 80 80 80 80 80 80 80 5D 56 5A 5A 64 66 70 6C 52 48 44 30 7F 7E 7E 7F 7F 7B 7E 7C 7A 7A 7E 7F FF 11 0C 00 08 1E F2 E4 DD DC ED F6
			15 01 00 00 00 00 02 B0 93
			39 01 00 00 00 00 32 CB 0B 80 80 80 80 80 80 80 80 80 80 80 80 5D 48 60 66 64 74 76 74 74 80 7A 5E 7F 77 7A 7E 7F 7F 7E 7E 7F 7F 7F 7B FF 2B 22 11 07 0A FB F4 02 03 F2 E0
			05 01 00 00 00 00 02 29 00
		];

		qcom,mdss-dsi-on-command = [
			39 01 00 00 00 00 03 7F 5A 5A
			39 01 00 00 00 00 03 F0 5A 5A
			39 01 00 00 00 00 03 F1 5A 5A
			39 01 00 00 00 00 03 F2 5A 5A
			15 01 00 00 00 00 02 02 01
			15 01 00 00 00 00 02 36 02
			15 01 00 00 00 00 02 53 20
			15 01 00 00 00 00 02 57 64
			15 01 00 00 00 00 02 58 00
			15 01 00 00 00 00 02 35 01
			05 01 00 00 78 00 02 11 00
			15 01 00 00 00 00 02 B0 00
			39 01 00 00 00 00 32 CB 0B 80 80 80 80 80 80 80 80 80 80 80 80 80 80 80 80 80 80 80 80 80 80 80 80 7F 7F 7F 7F 7F 7F 7F 7F 7F 7F 7F 7F FF FF FF FF FF FF FF FF FF FF FF FF
			15 01 00 00 00 00 02 B0 31
			39 01 00 00 00 00 32 CB 0B 80 80 80 80 80 80 80 80 80 80 80 80 5C 64 6E 60 7C 70 7A 78 6C 5E 5E 52 7F 7E 7F 7E 7F 7D 7F 7E 7E 7F 7F 7F FF 0C 03 ED 06 15 F6 F2 ED 00 00 F6
			15 01 00 00 00 00 02 B0 62
			39 01 00 00 00 00 32 CB 0B 80 80 80 80 80 80 80 80 80 80 80 80 5D 56 5A 5A 64 66 70 6C 52 48 44 30 7F 7E 7E 7F 7F 7B 7E 7C 7A 7A 7E 7F FF 11 0C 00 08 1E F2 E4 DD DC ED F6
			15 01 00 00 00 00 02 B0 93
			39 01 00 00 00 00 32 CB 0B 80 80 80 80 80 80 80 80 80 80 80 80 5D 48 60 66 64 74 76 74 74 80 7A 5E 7F 77 7A 7E 7F 7F 7E 7E 7F 7F 7F 7B FF 2B 22 11 07 0A FB F4 02 03 F2 E0
			05 01 00 00 00 00 02 29 00
		];

		//qcom,mdss-dsi-post-panel-on-command = [05 01 00 00 a0 00 01 29];

		qcom,mdss-dsi-off-command = [
			05 01 00 00 00 00 02 28 00
			05 01 00 00 64 00 02 10 00
		];

		qcom,compression-mode = "dsc";
		qcom,config-select = <&dsi_lgd_v2_wqhd_dsc_cmd_config0>;

		dsi_lgd_v2_wqhd_dsc_cmd_config0: config0 {
			qcom,mdss-dsc-encoders = <1>;
			qcom,mdss-dsc-slice-height = <16>;
			qcom,mdss-dsc-slice-width = <1440>;
			qcom,mdss-dsc-slice-per-pkt = <1>;

			qcom,mdss-dsc-bit-per-component = <8>;
			qcom,mdss-dsc-bit-per-pixel = <8>;
			qcom,mdss-dsc-block-prediction-enable;
		};
	};
};
