&soc {
	hallsensor {
			compatible = "fih,hallsensor";
			interrupt-parent = <&tlmm>;
			interrupts = <124 0x3>;
			hallsensor,irq-gpio  = <&tlmm 124 0x00>;
			vdd-supply = <&pm8998_lvs2>;
			hall-open,linux,code = <0x2f0>;
			hall-close,linux,code = <0x2f1>;
	};
};
