## drivers/char/i2c_devinfo/Kconfig
```kconfig
config I2C_DEVINFO
    tristate "I2c devices info for I2C testing"
    default n
    help
    This is the i2c-devinfo driver for android system
```

## drivers/input/fingerprint/Kconfig
```kconfig
menu "Nokia Fingerprints"

config SILEAD_FP
	tristate "silead fingerprint drivers"
	default n
	help
	  Say Y here if you want to use silead fingerprint soc drivers.

	  If unsure, say N.

config SUNWAVE_FP
       tristate "Sunwave Fingerprint"
       default n
       help
		  Say Y here if you want to use Sunwave fingerprint soc drivers.

config CDFINGER_FP
       tristate "Cdfinger Fingerprint"
       default n
       help
		  Say Y here if you want to use Cdfinger fingerprint soc drivers.

# Configuration for FPC
config FINGER_PRINT
        bool "Finger Print Driver"
        default n
        ---help---
          This is a Finger Print Drive

endmenu

source "drivers/input/fingerprint/goodix_gfx18m/Kconfig"
source "drivers/input/fingerprint/goodix_gf5288/Kconfig"
```

## drivers/input/fingerprint/goodix_gf5288/Kconfig
```kconfig
#
# Configuration for Goodix GF5288
#

config INPUT_GF5288
	bool "GOODIX GF5288 Driver" 
	default n
	---help---
	  This is a GOODIX GF5288 chipset Driver.
```

## drivers/input/misc/vl53L0_cci/Kconfig
```kconfig
config INPUT_STMVL53L0_CCI
	tristate "STM VL53L0 Proximity support"
	depends on MSM_CCI
	default n
	help
	  Say Y here if you want to use STMicroelectronics's proximity sensor
	  through I2C interface.

	  To compile this driver as a module, choose M here: the
	  module will be called stmvl53L0.
```

## drivers/platform/longcheer/Kconfig
```kconfig
# Longcheer configuration options
config MACH_LONGCHEER
	default n
	depends on ARCH_QCOM
	bool "Longcheer board"
	help
	  Support for Nokia Longcheer boards
```
