&i2c1 {
	lg4894@28 {
		status = "okay";
		compatible = "lge,lg4894";
		reg = <0x28>;
		interrupt-parent = <&eintc>;
		interrupts = <10 0x02>;
		debounce = <10 0>;
		irqflags = <0x00002002>;

		chip_flags = <0x102>;

		//pinctrl-names = "pmx_ts_active","pmx_ts_suspend";
		//pinctrl-0 = <&ts_int_active>;
		//pinctrl-1 = <&ts_int_suspend>;

		reset-gpio = <&pio 62 0x00>;
		irq-gpio = <&eintc 10 0x2008>;

		/* Caps */
		max_x = <720>;
		max_y = <1280>;
		max_pressure = <0xff>;
		max_width = <15>;
		max_orientation = <1>;
		max_id = <10>;

		/* role */
		hw_reset_delay = <210>;
		sw_reset_delay = <90>;
		use_lpwg = <1>;
		use_lpwg_test = <1>;

		/* firmware */
		use_fw_upgrade = <0>;
		use_firmware = <0>;
		fw_image = "sic/lg4894/ph1/L0W57PH1_0_02.img";	/* LG4894 for PH1 panel */
		panel_spec = "sic/lg4894/ph1/ph1_limit.txt";
		panel_spec_mfts = "sic/lg4894/ph1/ph1_limit_mfts.txt";
	};
};

