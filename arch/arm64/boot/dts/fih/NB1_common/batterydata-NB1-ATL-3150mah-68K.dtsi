/* Copyright (c) 2016, The Linux Foundation. All rights reserved.
 *
 * This program is free software; you can redistribute it and/or modify
 * it under the terms of the GNU General Public License version 2 and
 * only version 2 as published by the Free Software Foundation.
 *
 * This program is distributed in the hope that it will be useful,
 * but WITHOUT ANY WARRANTY; without even the implied warranty of
 * MERCHANTABILITY or FITNESS FOR A PARTICULAR PURPOSE.  See the
 * GNU General Public License for more details.
 */

qcom,NB1_ATL_3150mah_68K {
	qcom, = <24>;
	/* #Itech_B00826LF_3000mAh_ver1660_averaged_MasterSlave_Jul20th2016*/
	qcom,max-voltage-uv = <4400000>;
	qcom,fg-cc-cv-threshold-mv = <4390>;
	qcom,nom-batt-capacity-mah = <3150>;
	qcom,fastchg-current-ma = <3000>;
	qcom,batt-id-kohm = <68>;
	qcom,battery-beta = <3450>;
	qcom,battery-type = "NB1_ATL_3150mah_68K";
	qcom,checksum = <0x46B5>;
	qcom,gui-version = "PMI8998GUI - 2.0.0.54";
	/* Battery Tuning */
	qcom,fg-jeita-thresholds = <0 20 50 55>;
	/* [END] */
	qcom,fg-profile-data = [
		 84 1F 92 05
		 96 0A 26 06
		 77 1D 57 07
		 32 12 50 14
		 70 19 FD 1B
		 5A 3D 5E 4A
		 52 00 00 00
		 16 00 00 00
		 00 00 44 BC
		 50 C5 F9 B2
		 1B 00 08 00
		 B7 E2 EF ED
		 DB 06 8F F2
		 13 FB CD 12
		 69 FD FC 32
		 18 06 09 20
		 27 00 14 00
		 06 20 30 05
		 D4 0A F0 05
		 31 1D 9D FA
		 27 D5 1A 05
		 77 19 88 22
		 F0 45 3F 52
		 59 00 00 00
		 0D 00 00 00
		 00 00 39 CD
		 4E BA 0D A2
		 18 00 00 00
		 C9 EA EF ED
		 83 F4 5A EB
		 80 00 B6 0A
		 14 D4 F7 13
		 A5 33 CC FF
		 07 10 00 00
		 9B 0C 66 46
		 18 00 40 00
		 C0 01 0A FA
		 FF 00 00 00
		 00 00 00 00
		 00 00 00 00
		 00 00 00 00
		 00 00 00 00
		 00 00 00 00
		 00 00 00 00
		 00 00 00 00
		 00 00 00 00
		 00 00 00 00
		 00 00 00 00
		 00 00 00 00
		 00 00 00 00
		 00 00 00 00
		 00 00 00 00
		 00 00 00 00
		 00 00 00 00
		 00 00 00 00
		 00 00 00 00
	];
};
