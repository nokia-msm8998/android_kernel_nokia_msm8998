&pm8998_gpios {
        /* GPIO 14 for LCM_RTC_CLK */
        gpio@cd00 {
                status = "okay";
        };
};
&spi_5{
	lg4946@1 {
                status = "okay";
                compatible = "siw,lg4946";
                reg = <0x1>;
                spi-max-frequency = <10000000>;//10000000 from lg
                interrupt-parent = <&tlmm>;
                interrupts = <125 0x2008>;

                irqflags = <0x2002>;            // IRQF_ONESHOT(0x2000) | IRQF_TRIGGER_FALLING(0x2)
                chip_flags = <0x00>;            // TOUCH_USE_PWRCTRL(0x400)

                /* GPIOs */
                reset-gpio = <&tlmm 89 0x00>;
                irq-gpio = <&tlmm 125 0x00>;
                //irq-gpio = <&tlmm 125 0x6008>;

                //pinctrl-names = "pmx_ts_active","pmx_ts_suspend";
                //pinctrl-0 = <&ts_int_active &ts_reset_active>;
                //pinctrl-1 = <&ts_int_suspend &ts_reset_suspend>;

		/* Caps */
                max_x = <1440>;
                max_y = <2560>;
                max_pressure = <0xff>;
                max_width = <15>;
                max_orientation = <1>;
                max_id = <10>;

                /* role */
                hw_reset_delay = <210>;
                sw_reset_delay = <90>;
                use_lpwg = <1>;
                use_lpwg_test = <1>;

                /* firmware */
                use_fw_upgrade = <1>;
                use_firmware = <1>;
                fw_image = "TP_Firmware_LG4946";
                //panel_spec = "sic/lg4894/ph1/ph1_limit.txt";
                //panel_spec_mfts = "sic/lg4894/ph1/ph1_limit_mfts.txt";
                //prd_in_file = "/system/etc/lg4946_test_spec.txt";
                prd_in_file = "/vendor/etc/lg4946_test_spec.txt";
                prd_out_file = "/data/vendor/misc/touch/lg4946_test_result";
                /* LCM_RTC_CLK */
                qcom,RTC_CLK-gpios = <&pm8998_gpios 14 0>;
        };

};
