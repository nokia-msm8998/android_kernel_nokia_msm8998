
qcom,m690_veken_3500mah_pm660 {
	/*qcom, = <24>;*/
	/* #3931680_LC_M690_Veken_3500mAH_PM660_averaged_MasterSlave_Apr24th2019*/
	qcom,max-voltage-uv = <4400000>;
	qcom,fg-cc-cv-threshold-mv = <4390>;
	qcom,nom-batt-capacity-mah = <3500>;
	qcom,fastchg-current-ma = <2000>;
	qcom,batt-id-kohm = <47>;
	qcom,battery-beta = <3435>;
	qcom,battery-type = "m690_veken_3500mah_pm660";
	qcom,checksum = <0x8176>;
	qcom,gui-version = "PM660GUI - 0.0.0.45";
	qcom,fg-profile-data = [
		 DA 1E DB FC
		 C2 03 DC 06
		 DA 1C 16 02
		 6C 0D 0E 0B
		 15 18 B5 23
		 68 44 63 5A
		 69 00 00 00
		 10 00 00 00
		 00 00 00 00
		 DD CD 62 B3
		 1E 00 08 00
		 22 D3 2D E5
		 E7 05 AB FA
		 EF F4 E4 12
		 D5 F4 95 2A
		 2A 06 09 20
		 27 00 14 00
		 C0 1F 89 05
		 8E 0A 61 FC
		 B7 1C 31 03
		 C4 15 76 12
		 81 18 F2 23
		 C4 4D 84 5B
		 67 00 00 00
		 0D 00 00 00
		 00 00 A7 D5
		 44 CA 0C C3
		 17 00 00 00
		 4E 00 2D E5
		 4F FD FE F2
		 9F F4 E2 02
		 95 EA 56 1B
		 B4 33 CC FF
		 07 10 00 00
		 AA 0D 66 46
		 17 00 40 00
		 B1 01 0A FA
		 FF 00 00 00
		 00 00 00 00
		 00 00 00 00
		 00 00 00 00
		 00 00 00 00
		 00 00 00 00
		 00 00 00 00
		 00 00 00 00
		 00 00 00 00
		 00 00 00 00
		 00 00 00 00
		 00 00 00 00
		 00 00 00 00
		 00 00 00 00
		 00 00 00 00
		 00 00 00 00
		 00 00 00 00
		 00 00 00 00
		 00 00 00 00
	];
};
