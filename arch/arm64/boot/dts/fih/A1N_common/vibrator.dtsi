&pmi8998_haptics {
	status = "okay";
	qcom,ilim-ma = <400>;
	qcom,wave-shape = "sine";
	qcom,wave-play-rate-us = <4255>;
	qcom,vmax-mv = <1800>;
	qcom,brake-pattern = <0x3 0x3 0x3 0x3>;
	qcom,lra-auto-res-mode = "none";
	/delete-property/ qcom,lra-high-z;
	/delete-property/ qcom,lra-res-cal-period;
	qcom,wave-samples = [28 28 28 28 28 28 28 28];
};
