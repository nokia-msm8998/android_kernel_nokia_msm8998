&pmi8998_haptics {
	status = "okay";
	qcom,ilim-ma = <400>;
	qcom,wave-shape = "sine";
	qcom,wave-play-rate-us = <4878>;
	qcom,vmax-mv = <2200>;
	qcom,en-brake;
	qcom,brake-pattern = <0x3 0x2 0x1 0x0>;
	qcom,lra-auto-res-mode = "none";
	/delete-property/ qcom,lra-high-z;
	/delete-property/ qcom,lra-res-cal-period;
	qcom,wave-samples = [28 28 28 28 28 28 28 28];
};
