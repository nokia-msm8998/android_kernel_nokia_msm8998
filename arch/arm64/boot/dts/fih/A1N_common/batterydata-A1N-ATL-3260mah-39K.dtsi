/* Copyright (c) 2016, The Linux Foundation. All rights reserved.
 *
 * This program is free software; you can redistribute it and/or modify
 * it under the terms of the GNU General Public License version 2 and
 * only version 2 as published by the Free Software Foundation.
 *
 * This program is distributed in the hope that it will be useful,
 * but WITHOUT ANY WARRANTY; without even the implied warranty of
 * MERCHANTABILITY or FITNESS FOR A PARTICULAR PURPOSE.  See the
 * GNU General Public License for more details.
 */

qcom,A1N_ATL_3260mah_39K {
	qcom, = <24>;
	/* #2931734_FIH_HE333_3260mAh_averaged_MasterSlave_May30th2017*/
	qcom,max-voltage-uv = <4400000>;
	qcom,fg-cc-cv-threshold-mv = <4390>;
	qcom,nom-batt-capacity-mah = <3260>;
	qcom,fastchg-current-ma = <3260>;
	qcom,batt-id-kohm = <39>;
	qcom,battery-beta = <3450>;
	qcom,battery-type = "A1N_ATL_3260mah_39K";
	qcom,checksum = <0x242A>;
	qcom,gui-version = "PMI8998GUI - 2.0.0.58";
	/* Battery Tuning */
	qcom,fg-jeita-thresholds = <0 15 45 55>;
	fih,jeita-full-capacity-warm-en;
	/* [END] */
	qcom,fg-profile-data = [
		 7C 1F 9E 05
		 85 0A 77 FC
		 85 1D 4D F4
		 85 12 E8 1D
		 E2 18 C7 22
		 BA 45 86 52
		 57 00 00 00
		 0F 00 00 00
		 00 00 30 C4
		 36 C5 BD BB
		 18 00 08 00
		 2F D3 D1 E5
		 89 FD 73 EB
		 42 F2 E9 0A
		 17 14 1B 4C
		 07 06 09 20
		 27 00 14 00
		 B9 1F 84 05
		 8D 0A 79 FC
		 50 1D 6E F2
		 A8 03 BC 15
		 3F 19 C9 22
		 97 45 D2 52
		 53 00 00 00
		 0D 00 00 00
		 00 00 82 CC
		 6F BB F9 B2
		 16 00 00 00
		 96 E3 D1 E5
		 DD 06 EA EA
		 1F F3 C0 0A
		 91 FA 7B 1A
		 B7 33 CC FF
		 07 10 00 00
		 D6 0C 66 46
		 16 00 40 00
		 B9 01 0A FA
		 FF 00 00 00
		 00 00 00 00
		 00 00 00 00
		 00 00 00 00
		 00 00 00 00
		 00 00 00 00
		 00 00 00 00
		 00 00 00 00
		 00 00 00 00
		 00 00 00 00
		 00 00 00 00
		 00 00 00 00
		 00 00 00 00
		 00 00 00 00
		 00 00 00 00
		 00 00 00 00
		 00 00 00 00
		 00 00 00 00
		 00 00 00 00
	];
};
