/* Battery profile*/
&vendor {
	mtp_batterydata: qcom,battery-data {
		#include "batterydata-NB1-Coslight-3150mah-100K.dtsi"
		#include "batterydata-NB1-ATL-3150mah-68K.dtsi"
		#include "batterydata-NB1-ATL-3090mah-39K.dtsi"
	};
};

/* Fuel Gauge */
&pmi8998_fg {
	qcom,fg-cutoff-voltage = <3300>;
	qcom,fg-empty-voltage = <3200>;
	qcom,fg-chg-term-current = <63>; /* 0.02C */
	qcom,fg-sys-term-current = <(-250)>;
	qcom,fg-auto-recharge-soc;
	qcom,fg-recharge-soc-thr = <99>;
	qcom,hold-soc-while-full;
	qcom,battery-thermal-coefficients = [A2 50 FF];
	qcom,linearize-soc;
};

/* pmi8998 charger */
&pmi8998_charger {
	qcom,usb-icl-ua = <3000000>;
	qcom,fcc-max-ua = <3000000>;
	qcom,fv-max-uv = <4400000>;
	qcom,jeita-fcc-comp = <600000>;
	qcom,jeita-fv-comp = <300000>;
	qcom,step-charging-enable;
	qcom,sw-jeita-enable;
	qcom,thermal-mitigation = <3000000 1200000 900000 300000>;
	qcom,auto-recharge-soc;
	fih,show-batt-info-en;
	fih,chg-abnormal-check-en;
};
