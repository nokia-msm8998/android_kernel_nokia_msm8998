
&spi_5{
	synaptics_dsx@0 {
                status = "okay";
                compatible = "synaptics,dsx-spi";
                reg = <0>;
                spi-max-frequency = <5000000>;
                interrupt-parent = <&tlmm>;
                interrupts = <125 0x2008>;
                vdd_ana-supply = <&pm8998_l28>;
                vcc_i2c-supply = <&pm8998_l14>;
                synaptics,pwr-reg-name = "vdd_ana";
                synaptics,bus-reg-name = "vcc_i2c";
                ibb-supply = <&ibb_regulator>;
                lab-supply = <&lab_regulator>;
                synaptics,ibb-reg-name = "ibb";
                synaptics,lab-reg-name = "lab";
                synaptics,irq-gpio = <&tlmm 125 0x2008>; // IRQF_ONESHOT | IRQF_TRIGGER_LOW
                synaptics,irq-on-state = <0>;
                synaptics,byte-delay-us = <20>;
                synaptics,block-delay-us = <20>;
                synaptics,address-delay-us = <20>;
                synaptics,power-delay-ms = <200>;
                synaptics,reset-gpio = <&tlmm 89 0x00>;
                synaptics,reset-delay-ms = <100>;
                synaptics,reset-on-state = <0>;
                synaptics,reset-active-ms = <20>;
                synaptics,x-flip;//flip for NB1 LCM/TP
                synaptics,y-flip;//flip for NB1 LCM/TP
                // uncomment and update line below as appropriate if there are 0D buttons
		// synaptics,cap-button-codes = <102 158>;
                // uncomment and update lines below as appropriate if there are virtual buttons
                // synaptics,vir-button-codes = <102 100 900 100 60 158 300 900 100 60>;
                // synaptics,max-y-for-2d = <800>;
	};
};
	
