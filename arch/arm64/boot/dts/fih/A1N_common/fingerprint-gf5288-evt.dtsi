&soc {
	gf5288 {
		compatible = "goodix,fingerprint";
		status = "okay";
		interrupt-parent = <&tlmm>;
		interrupts = <0 121 0>;
		fp-gpio-reset = <&tlmm 62 0x0>;
		fp-gpio-irq = <&tlmm 121 0x0>;
		goodix,key-customer-define = <1>;
		vdd_io-supply = <&fp_avdd_vreg>;
	};
};
