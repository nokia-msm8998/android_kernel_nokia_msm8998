&soc {
	i2c@78b9000 { /* BLSP1 QUP5 */
		qcom,clk-freq-out = <400000>;

		lg4894@28 {
			status = "okay";
			compatible = "lge,lg4894";
			reg = <0x28>;

			/* GPIOs */
			reset-gpio	=	<&msm_gpio 2 0x00>;
			irq-gpio	=	<&msm_gpio 3 0x6008>;

			pinctrl-names = "pmx_ts_active","pmx_ts_suspend";
			pinctrl-0 = <&ts_int_active &ts_reset_active>;
			pinctrl-1 = <&ts_int_suspend &ts_reset_suspend>;

			/* Caps */
			max_x = <720>;
			max_y = <1280>;
			max_pressure = <0xff>;
			max_width = <15>;
			max_orientation = <1>;
			max_id = <10>;

			/* role */
			hw_reset_delay = <210>;
			sw_reset_delay = <90>;
			use_lpwg = <1>;
			use_lpwg_test = <1>;

			/* firmware */
			//use_fw_upgrade = <1>;
			use_firmware = <0>;
			//fw_image = "sic/lg4894/ph1/L0W57PH1_0_02.img";	/* LG4894 for PH1 panel */
			//panel_spec = "sic/lg4894/ph1/ph1_limit.txt";
			//panel_spec_mfts = "sic/lg4894/ph1/ph1_limit_mfts.txt";
		};
	};
};

